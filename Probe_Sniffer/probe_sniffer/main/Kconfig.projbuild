## Probe_Sniffer/probe_sniffer/main/Kconfig.projbuild
```kconfig
menu "Probe Sniffer Configuration"

config WIFI_SSID
    string "Wi-Fi SSID"
    default "Vodafone-homeRM"
    help
	SSID (network name) for the example to connect to.

config WIFI_PASSWORD
    string "Wi-Fi Password"
    default "ExtraunioneelaFortezza!?300591"
    help
	WiFi password (WPA or WPA2) for the example to use.

endmenu
```

## bin/Probe_Sniffer/probe_sniffer/main/Kconfig.projbuild
```kconfig
menu "Probe Sniffer Configuration"

config WIFI_SSID
    string "Wi-Fi SSID"
    default "HUAWEI P10"
    help
	SSID (network name) for the example to connect to.

config WIFI_PASSWORD
    string "Wi-Fi Password"
    default "777888keke"
    help
	WiFi password (WPA or WPA2) for the example to use.

endmenu
```
